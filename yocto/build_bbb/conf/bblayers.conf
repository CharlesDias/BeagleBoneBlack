## yocto/build_bbb/conf/bblayers.conf
```bitbake
# POKY_BBLAYERS_CONF_VERSION is increased each time build/conf/bblayers.conf
# changes incompatibly
POKY_BBLAYERS_CONF_VERSION = "2"

BBPATH = "${TOPDIR}"
BBFILES ?= ""

BBLAYERS ?= " \
  /home/charlesdias/Code_Study/Linux/BeagleBoneBlack/GitHub/yocto/poky/meta \
  /home/charlesdias/Code_Study/Linux/BeagleBoneBlack/GitHub/yocto/poky/meta-poky \
  /home/charlesdias/Code_Study/Linux/BeagleBoneBlack/GitHub/yocto/poky/meta-yocto-bsp \
  "
```
